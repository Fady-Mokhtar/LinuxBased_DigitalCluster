## conf/bblayers.conf
```bitbake
# POKY_BBLAYERS_CONF_VERSION is increased each time build/conf/bblayers.conf
# changes incompatibly
POKY_BBLAYERS_CONF_VERSION = "2"

BBPATH = "${TOPDIR}"
BBFILES ?= ""


BBLAYERS ?= " \
  /home/omar/yocto/poky/meta \
  /home/omar/yocto/poky/meta-poky \
  /home/omar/yocto/poky/meta-yocto-bsp \
  /home/omar/yocto/poky/meta-openembedded/meta-oe \
  /home/omar/yocto/poky/meta-openembedded/meta-python \
  /home/omar/yocto/poky/meta-openembedded/meta-networking \
  /home/omar/yocto/poky/meta-openembedded/meta-multimedia \
  /home/omar/yocto/poky/meta-raspberrypi \
  /home/omar/yocto/poky/meta-qt5 \
  /home/omar/yocto/poky/meta-cluster-unit \
  "
```

## meta-cluster-unit/conf/layer.conf
```bitbake
# We have a conf and classes directory, add to BBPATH
BBPATH .= ":${LAYERDIR}"

# We have recipes-* directories, add to BBFILES
BBFILES += "${LAYERDIR}/recipes-*/*/*.bb \
            ${LAYERDIR}/recipes-*/*/*.bbappend \
            ${LAYERDIR}/calculator/*.bb"

BBFILE_COLLECTIONS += "meta-mero"
BBFILE_PATTERN_meta-mero = "^${LAYERDIR}/"
BBFILE_PRIORITY_meta-mero = "15"

LAYERDEPENDS_meta-mero = "core"
LAYERSERIES_COMPAT_meta-mero = "kirkstone"
```
